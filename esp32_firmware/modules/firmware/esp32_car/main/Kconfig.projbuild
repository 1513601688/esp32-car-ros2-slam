## esp32_firmware/modules/firmware/esp32_car/main/Kconfig.projbuild
```kconfig
menu "ESP32 Car Configuration"

    menu "WiFi Settings"
        config CAR_WIFI_SSID
            string "WiFi SSID"
            default "YOUR_ROUTER_SSID"
            help
                要连接的路由器名称

        config CAR_WIFI_PASSWORD
            string "WiFi Password"
            default "YOUR_ROUTER_PASSWORD"
            help
                路由器密码

        config CAR_WIFI_MAX_RETRY
            int "WiFi 最大重试次数"
            default 5
            range 1 20
            help
                WiFi 断连后最大重试次数
    endmenu

endmenu
```

## esp32_firmware/modules/firmware/esp32_car/sdkconfig.defaults
```kconfig
# ESP32-S3 N16R8 默认 SDK 配置

# 芯片目标
CONFIG_IDF_TARGET_ESP32S3=y
CONFIG_IDF_TARGET="esp32s3"

# Flash 配置
CONFIG_ESPTOOLPY_FLASHSIZE_16MB=y
CONFIG_ESPTOOLPY_FLASHSIZE="16MB"
CONFIG_ESPTOOLPY_FLASHMODE_QIO=y
CONFIG_ESPTOOLPY_FLASHFREQ_80M=y

# 分区表
CONFIG_PARTITION_TABLE_CUSTOM=y
CONFIG_PARTITION_TABLE_CUSTOM_FILENAME="partitions.csv"
CONFIG_PARTITION_TABLE_FILENAME="partitions.csv"

# SPIFFS
CONFIG_SPIFFS_MAX_PARTITIONS=1

# mDNS
CONFIG_MDNS_MAX_SERVICES=4

# FreeRTOS
CONFIG_FREERTOS_UNICORE=n

# HTTP Server
CONFIG_HTTPD_MAX_REQ_HDR_LEN=1024
CONFIG_HTTPD_MAX_URI_LEN=512
CONFIG_HTTPD_ERR_RESP_NO_DELAY=y
CONFIG_HTTPD_WS_SUPPORT=y

# Wi-Fi
# 实际名称和密码由 flash_gui.ps1 在烧录前写入本地 sdkconfig。
# 不要把真实凭据提交到版本库。
CONFIG_ESP_WIFI_STA_DISCONNECTED_PM_ENABLE=n
CONFIG_CAR_WIFI_SSID=""
CONFIG_CAR_WIFI_PASSWORD=""
CONFIG_CAR_WIFI_MAX_RETRY=5

# 主频
CONFIG_ESP_DEFAULT_CPU_FREQ_MHZ_240=y
CONFIG_ESP_DEFAULT_CPU_FREQ_MHZ=240
```
